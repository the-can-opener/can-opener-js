VERSION ""

NS_ :

BS_:

BU_: ECU

BA_DEF_ SG_ "SignalProtocol" STRING;
BA_DEF_ SG_ "Pid" INT 0 65535;
BA_DEF_ SG_ "RequestCanId" INT 0 536870911;
BA_DEF_ SG_ "ResponseCanId" INT 0 536870911;
BA_DEF_ SG_ "DiagnosticServiceId" INT 0 255;
BA_DEF_ SG_ "DiagnosticTransport" STRING;
BA_DEF_ SG_ "ResponseLength" INT 0 4095;
BA_DEF_ SG_ "SignalValueType" STRING;

BO_ 2024 OBD2_ResponsePayload: 64 ECU
 SG_ Engine_Load : 0|8@1+ (0.3921568627,0) [0|100] "%" ECU
 SG_ Coolant_Temp : 0|8@1+ (1,-40) [-40|215] "degC" ECU
 SG_ STFT_Bank1 : 0|8@1+ (0.78125,-100) [-100|99.2] "%" ECU
 SG_ LTFT_Bank1 : 0|8@1+ (0.78125,-100) [-100|99.2] "%" ECU
 SG_ Fuel_Pressure : 0|8@1+ (3,0) [0|765] "kPa" ECU
 SG_ MAP_Pressure : 0|8@1+ (1,0) [0|255] "kPa" ECU
 SG_ Engine_RPM : 7|16@0+ (0.25,0) [0|16383.75] "rpm" ECU
 SG_ Vehicle_Speed : 0|8@1+ (1,0) [0|255] "km/h" ECU
 SG_ Timing_Advance : 0|8@1+ (0.5,-64) [-64|63.5] "deg before TDC" ECU
 SG_ Intake_Air_Temp : 0|8@1+ (1,-40) [-40|215] "degC" ECU
 SG_ MAF_Flow_Rate : 7|16@0+ (0.01,0) [0|655.35] "g/s" ECU
 SG_ Throttle_Position : 0|8@1+ (0.3921568627,0) [0|100] "%" ECU
 SG_ Engine_Run_Time : 7|16@0+ (1,0) [0|65535] "s" ECU
 SG_ Fuel_Tank_Level : 0|8@1+ (0.3921568627,0) [0|100] "%" ECU
 SG_ Baro_Pressure : 0|8@1+ (1,0) [0|255] "kPa" ECU
 SG_ Module_Voltage : 7|16@0+ (0.001,0) [0|65.535] "V" ECU
 SG_ Fuel_Type : 0|8@1+ (1,0) [0|23] "" ECU
 SG_ Fuel_Rate : 7|16@0+ (0.05,0) [0|3276.75] "L/h" ECU
 SG_ VIN : 8|136@1+ (1,0) [0|0] "" ECU

BA_ "SignalProtocol" SG_ 2024 Engine_Load "pid";
BA_ "Pid" SG_ 2024 Engine_Load 4;
BA_ "RequestCanId" SG_ 2024 Engine_Load 2015;
BA_ "ResponseCanId" SG_ 2024 Engine_Load 2024;
BA_ "DiagnosticTransport" SG_ 2024 Engine_Load "single";

BA_ "SignalProtocol" SG_ 2024 Coolant_Temp "pid";
BA_ "Pid" SG_ 2024 Coolant_Temp 5;
BA_ "RequestCanId" SG_ 2024 Coolant_Temp 2015;
BA_ "ResponseCanId" SG_ 2024 Coolant_Temp 2024;
BA_ "DiagnosticTransport" SG_ 2024 Coolant_Temp "single";

BA_ "SignalProtocol" SG_ 2024 STFT_Bank1 "pid";
BA_ "Pid" SG_ 2024 STFT_Bank1 6;
BA_ "RequestCanId" SG_ 2024 STFT_Bank1 2015;
BA_ "ResponseCanId" SG_ 2024 STFT_Bank1 2024;
BA_ "DiagnosticTransport" SG_ 2024 STFT_Bank1 "single";

BA_ "SignalProtocol" SG_ 2024 LTFT_Bank1 "pid";
BA_ "Pid" SG_ 2024 LTFT_Bank1 7;
BA_ "RequestCanId" SG_ 2024 LTFT_Bank1 2015;
BA_ "ResponseCanId" SG_ 2024 LTFT_Bank1 2024;
BA_ "DiagnosticTransport" SG_ 2024 LTFT_Bank1 "single";

BA_ "SignalProtocol" SG_ 2024 Fuel_Pressure "pid";
BA_ "Pid" SG_ 2024 Fuel_Pressure 10;
BA_ "RequestCanId" SG_ 2024 Fuel_Pressure 2015;
BA_ "ResponseCanId" SG_ 2024 Fuel_Pressure 2024;
BA_ "DiagnosticTransport" SG_ 2024 Fuel_Pressure "single";

BA_ "SignalProtocol" SG_ 2024 MAP_Pressure "pid";
BA_ "Pid" SG_ 2024 MAP_Pressure 11;
BA_ "RequestCanId" SG_ 2024 MAP_Pressure 2015;
BA_ "ResponseCanId" SG_ 2024 MAP_Pressure 2024;
BA_ "DiagnosticTransport" SG_ 2024 MAP_Pressure "single";

BA_ "SignalProtocol" SG_ 2024 Engine_RPM "pid";
BA_ "Pid" SG_ 2024 Engine_RPM 12;
BA_ "RequestCanId" SG_ 2024 Engine_RPM 2015;
BA_ "ResponseCanId" SG_ 2024 Engine_RPM 2024;
BA_ "DiagnosticTransport" SG_ 2024 Engine_RPM "single";

BA_ "SignalProtocol" SG_ 2024 Vehicle_Speed "pid";
BA_ "Pid" SG_ 2024 Vehicle_Speed 13;
BA_ "RequestCanId" SG_ 2024 Vehicle_Speed 2015;
BA_ "ResponseCanId" SG_ 2024 Vehicle_Speed 2024;
BA_ "DiagnosticTransport" SG_ 2024 Vehicle_Speed "single";

BA_ "SignalProtocol" SG_ 2024 Timing_Advance "pid";
BA_ "Pid" SG_ 2024 Timing_Advance 14;
BA_ "RequestCanId" SG_ 2024 Timing_Advance 2015;
BA_ "ResponseCanId" SG_ 2024 Timing_Advance 2024;
BA_ "DiagnosticTransport" SG_ 2024 Timing_Advance "single";

BA_ "SignalProtocol" SG_ 2024 Intake_Air_Temp "pid";
BA_ "Pid" SG_ 2024 Intake_Air_Temp 15;
BA_ "RequestCanId" SG_ 2024 Intake_Air_Temp 2015;
BA_ "ResponseCanId" SG_ 2024 Intake_Air_Temp 2024;
BA_ "DiagnosticTransport" SG_ 2024 Intake_Air_Temp "single";

BA_ "SignalProtocol" SG_ 2024 MAF_Flow_Rate "pid";
BA_ "Pid" SG_ 2024 MAF_Flow_Rate 16;
BA_ "RequestCanId" SG_ 2024 MAF_Flow_Rate 2015;
BA_ "ResponseCanId" SG_ 2024 MAF_Flow_Rate 2024;
BA_ "DiagnosticTransport" SG_ 2024 MAF_Flow_Rate "single";

BA_ "SignalProtocol" SG_ 2024 Throttle_Position "pid";
BA_ "Pid" SG_ 2024 Throttle_Position 17;
BA_ "RequestCanId" SG_ 2024 Throttle_Position 2015;
BA_ "ResponseCanId" SG_ 2024 Throttle_Position 2024;
BA_ "DiagnosticTransport" SG_ 2024 Throttle_Position "single";

BA_ "SignalProtocol" SG_ 2024 Engine_Run_Time "pid";
BA_ "Pid" SG_ 2024 Engine_Run_Time 31;
BA_ "RequestCanId" SG_ 2024 Engine_Run_Time 2015;
BA_ "ResponseCanId" SG_ 2024 Engine_Run_Time 2024;
BA_ "DiagnosticTransport" SG_ 2024 Engine_Run_Time "single";

BA_ "SignalProtocol" SG_ 2024 Fuel_Tank_Level "pid";
BA_ "Pid" SG_ 2024 Fuel_Tank_Level 47;
BA_ "RequestCanId" SG_ 2024 Fuel_Tank_Level 2015;
BA_ "ResponseCanId" SG_ 2024 Fuel_Tank_Level 2024;
BA_ "DiagnosticTransport" SG_ 2024 Fuel_Tank_Level "single";

BA_ "SignalProtocol" SG_ 2024 Baro_Pressure "pid";
BA_ "Pid" SG_ 2024 Baro_Pressure 51;
BA_ "RequestCanId" SG_ 2024 Baro_Pressure 2015;
BA_ "ResponseCanId" SG_ 2024 Baro_Pressure 2024;
BA_ "DiagnosticTransport" SG_ 2024 Baro_Pressure "single";

BA_ "SignalProtocol" SG_ 2024 Module_Voltage "pid";
BA_ "Pid" SG_ 2024 Module_Voltage 66;
BA_ "RequestCanId" SG_ 2024 Module_Voltage 2015;
BA_ "ResponseCanId" SG_ 2024 Module_Voltage 2024;
BA_ "DiagnosticTransport" SG_ 2024 Module_Voltage "single";

BA_ "SignalProtocol" SG_ 2024 Fuel_Type "pid";
BA_ "Pid" SG_ 2024 Fuel_Type 81;
BA_ "RequestCanId" SG_ 2024 Fuel_Type 2015;
BA_ "ResponseCanId" SG_ 2024 Fuel_Type 2024;
BA_ "DiagnosticTransport" SG_ 2024 Fuel_Type "single";

BA_ "SignalProtocol" SG_ 2024 Fuel_Rate "pid";
BA_ "Pid" SG_ 2024 Fuel_Rate 94;
BA_ "RequestCanId" SG_ 2024 Fuel_Rate 2015;
BA_ "ResponseCanId" SG_ 2024 Fuel_Rate 2024;
BA_ "DiagnosticTransport" SG_ 2024 Fuel_Rate "single";

BA_ "SignalProtocol" SG_ 2024 VIN "pid";
BA_ "Pid" SG_ 2024 VIN 2;
BA_ "RequestCanId" SG_ 2024 VIN 2015;
BA_ "ResponseCanId" SG_ 2024 VIN 2024;
BA_ "DiagnosticServiceId" SG_ 2024 VIN 9;
BA_ "DiagnosticTransport" SG_ 2024 VIN "isotp";
BA_ "ResponseLength" SG_ 2024 VIN 18;
BA_ "SignalValueType" SG_ 2024 VIN "ascii";

CM_ BO_ 2024 "Logical OBD-II response payloads. The transport/device strips CAN and ISO-TP framing. The library strips response service + PID before applying these signal layouts.";
CM_ SG_ 2024 VIN "Mode 09 PID 02. Payload after 0x49 0x02 includes one information-type/count byte, then 17 ASCII VIN bytes.";

VAL_ 2024 Fuel_Type 0 "Not available" 1 "Gasoline" 2 "Methanol" 3 "Ethanol" 4 "Diesel" 5 "LPG" 6 "CNG" 7 "Propane" 8 "Electric" 9 "Bifuel gasoline" 10 "Bifuel methanol" 11 "Bifuel ethanol" 12 "Bifuel LPG" 13 "Bifuel CNG" 14 "Bifuel propane" 15 "Bifuel electricity" 16 "Bifuel electric/combustion" 17 "Hybrid gasoline" 18 "Hybrid ethanol" 19 "Hybrid diesel" 20 "Hybrid electric" 21 "Hybrid electric/combustion" 22 "Hybrid regenerative" 23 "Bifuel diesel" ;
